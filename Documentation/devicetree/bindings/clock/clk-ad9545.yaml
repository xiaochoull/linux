## Documentation/devicetree/bindings/clock/clk-ad9545.yaml
```yaml
# SPDX-License-Identifier: (GPL-2.0-only OR BSD-2-Clause)
%YAML 1.2
---
$id: http://devicetree.org/schemas/clock/adi,ad9545.yaml#
$schema: http://devicetree.org/meta-schemas/core.yaml#

title: Analog Devices AD9545 Quad Input, 10-Output, Dual DPLL/IEEE 1588

maintainers:
  - Alexandru Tachici <alexandru.tachici@analog.com>

description: |
  Analog Devices AD9545 Quad Input, 10-Output, Dual DPLL/IEEE 1588,
  1 pps Synchronizer and Jitter Cleaner
  https://www.analog.com/media/en/technical-documentation/data-sheets/ADM1266.pdf

properties:
  compatible:
    enum:
      - adi,ad9545

  reg:
    description: |
      I2C address of the secondary device.

  avcc-supply:
    description: |
      Phandle to the Avcc power supply.

  adi,freq-doubler:
    description: |
      The system clock PLL provides the user with the option of doubling the reference frequency.
    type: boolean

  adi,ref-crystal:
    description: |
      At XOA,XOB there is a crystal connected that needs maintaining.
      Otherwise it is assumed that there is a TCXO or OCXO connected.
    type: boolean

  adi,ref-frequency-mhz:
    description: |
      Reference input frequency at XOA,XOB. This is used for the system clock.
    allOf:
      - $ref: /schemas/types.yaml#/definitions/uint32-array
    minItems: 2
    maxItems: 2

patternProperties:
  "^ref-input-clk@[0-3]$":
    description: |
      Represents a reference clock input.
    type: object

    properties:
      reg:
        description: |
          The reference input number. It can have up to 4 input clocks numbered from 0 to 3.
          (mapped: [refa, refaa, refb, refbb] -> [0, 1, 2, 3])
        maxItems: 1

      adi,single-ended-mode:
        description: |
          Single-ended configuration mode.
        allOf:
          - $ref: /schemas/types.yaml#/definitions/uint32
          - enum: [0, 1, 2, 3]
        maxItems: 1

      adi,differential-mode:
        description: |
          Differential configuration mode.
        allOf:
          - $ref: /schemas/types.yaml#/definitions/uint32
          - enum: [0, 1, 2]
        maxItems: 1

      adi,r-divider-ratio:
        description: |
          Each reference input has a dedicated divider.
        allOf:
          - $ref: /schemas/types.yaml#/definitions/uint32
          - minimum: 0
          - maximum: 0x40000000
        maxItems: 1

required:
  - compatible
  - reg

examples:
  - |
    ad9545@4A {
      compatible = "adi,ad9545";
      reg = <0x4A>;
      #address-cells = <1>;
      #size-cells = <0>;

      adi,ref-compensation;
      adi,freq-doubler;
      adi,ref-crystal;
      adi,ref-frequency-mhz = <0x71B00000 0xB>;

      /* ref a*/
      ref-input-clk@0 {
        reg = <0>;
        adi,single-ended-mode = <DRIVER_MODE_DC_COUPLED_1V2>;
        adi,r-divider-ratio = <50>;
       };

      /* ref aa*/
      ref-input-clk@1 {
        reg = <1>;
        adi,single-ended-mode = <DRIVER_MODE_AC_COUPLED>;
        adi,r-divider-ratio = <50>;
      };

      /* ref b*/
      ref-input-clk@2 {
        reg = <2>;
        adi,single-ended-mode = <DRIVER_MODE_DC_COUPLED_1V8>;
        adi,r-divider-ratio = <125>;
      };

      /* ref bb*/
      ref-input-clk@3 {
        reg = <3>;
        adi,single-ended-mode = <DRIVER_MODE_AC_COUPLED>;
      };
    };
...
```
